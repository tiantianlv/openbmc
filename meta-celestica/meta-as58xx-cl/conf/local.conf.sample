## meta-celestica/meta-as58xx-cl/conf/local.conf.sample
```bitbake
#
# Local configuration file for building the OpenBMC image.
#

# Machine Selection
MACHINE ??= "as58xx-cl"

# OpenBMC distro settings
DISTRO ?= "openbmc-fb"
```

## meta-celestica/meta-questone2/conf/layer.conf
```bitbake
# We have a conf and classes directory, add to BBPATH
BBPATH .= ":${LAYERDIR}"

# We have recipes-* directories, add to BBFILES
BBFILES += "${LAYERDIR}/recipes-*/*/*.bb \
	${LAYERDIR}/recipes-*/*/*.bbappend"

BBFILE_COLLECTIONS += "questone2"
BBFILE_PATTERN_questone2 = "^${LAYERDIR}/"
BBFILE_PRIORITY_questone2 = "21"
```

## meta-celestica/meta-questone2/conf/local.conf
```bitbake
#
# Local configuration file for building the OpenBMC image.
#

# Machine Selection
MACHINE ??= "questone2"

# OpenBMC distro settings
DISTRO ?= "openbmc-fb"

DL_DIR ?= "/home/zmzhan/workstations/openbmc/download"
```

## meta-celestica/meta-questone2/conf/local.conf.sample
```bitbake
#
# Local configuration file for building the OpenBMC image.
#

# Machine Selection
MACHINE ??= "questone2"

# OpenBMC distro settings
DISTRO ?= "openbmc-fb"
```
